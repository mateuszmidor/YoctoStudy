## CustomLayerAndRecipe/build/conf/bblayers.conf
```bitbake
# POKY_BBLAYERS_CONF_VERSION is increased each time build/conf/bblayers.conf
# changes incompatibly
POKY_BBLAYERS_CONF_VERSION = "2"

BBPATH = "${TOPDIR}"
BSPDIR := "${@os.path.abspath(os.path.dirname(d.getVar('FILE', True)) + '/../..')}"
BBFILES ?= ""

BBLAYERS ?= " \
  ${BSPDIR}/meta \
  ${BSPDIR}/meta-poky \
  ${BSPDIR}/meta-yocto-bsp \
  ${BSPDIR}/meta-custom \
  "
```

## bitbake_hello_world/conf/bblayers.conf
```bitbake
# get project dir 
PROJDIR := "${@os.path.abspath(os.path.dirname(d.getVar('FILE', True)) + '/..')}"

# add mylayer
BBLAYERS ?= " \
	${PROJDIR}/meta-mylayer \
"
```
